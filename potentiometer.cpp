//-----------------------------------------------------------------------------
#include <avr/pgmspace.h>
#include "potentiometer.h"
//-----------------------------------------------------------------------------
#define HYSTERESIS_WIDTH    4
//-----------------------------------------------------------------------------
const PROGMEM BYTE sin_p_table[721] = { 0, 2, 4, 7, 9, 11, 13, 16, 18, 20, 22, 24, 27,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 0, 0 };
const PROGMEM BYTE sin_n_table[721] = { 0, 0, 0, 0, 0, 0, 0, 0, 0, 0, 0, 0, 0,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 2, 0 };
const PROGMEM BYTE cos_p_table[721] = { 255, 255, 254, 254, 253, 253, 253, 252, 252, 251, 251, 250, 249,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 255, 255 };
const PROGMEM BYTE cos_n_table[721] = { 0, 0, 0, 0, 0, 0, 0, 0, 0, 0, 0, 0, 0,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 0, 0 };
//-----------------------------------------------------------------------------
void set_position(WORD angle)
{
    static WORD prev_angle = 0;
    static char boost = 0;
    BYTE tmp;

    if(angle > prev_angle)
    {
        boost = HYSTERESIS_WIDTH;
    }
    if(angle < prev_angle)
    {
        boost = - HYSTERESIS_WIDTH;
    }
    prev_angle = angle;

    angle += boost;

    // SIN_P
    tmp = pgm_read_byte(sin_p_table + angle);
    if(tmp)
    {
        set_bit(SIN_TCCR, SIN_P_COM);
        SIN_P_OCR = tmp;
    }
    else
    {
        clr_bit(SIN_TCCR, SIN_P_COM);
    }

    tmp = pgm_read_byte(sin_n_table + angle);
    if(tmp)
    {
        set_bit(SIN_TCCR, SIN_N_COM);
        SIN_N_OCR = tmp;
    }
    else
    {
        clr_bit(SIN_TCCR, SIN_N_COM);
    }

    // COS_P
    tmp = pgm_read_byte(cos_p_table + angle);
    if(tmp)
    {
        set_bit(COS_TCCR, COS_P_COM);
        COS_P_OCR = tmp;
    }
    else
    {
        clr_bit(COS_TCCR, COS_P_COM);
    }

    // COS_N
    tmp = pgm_read_byte(cos_n_table + angle);
    if(tmp)
    {
        set_bit(COS_TCCR, COS_N_COM);
        COS_N_OCR = tmp;
    }
    else
    {
        clr_bit(COS_TCCR, COS_N_COM);
    }
}
//-----------------------------------------------------------------------------
